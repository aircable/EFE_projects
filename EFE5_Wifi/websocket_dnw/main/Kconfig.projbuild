## EFE5_Wifi/websocket_dnw/main/Kconfig.projbuild
```kconfig
menu "WIFI CONNECT"

config WIFI_SSID
    string "SSID"
    default "my ssid"

config WIFI_PASSWORD
    string "PASSWORD"
    default "my password"  

config LED_GPIO
    int "Blink GPIO number"
    default 2
    help
        GPIO number for the LED.

endmenu
```

## EFE6_Website/wifi_config/main/Kconfig.projbuild
```kconfig
menu "COURSE Configuration"

    orsource "$IDF_PATH/examples/common_components/env_caps/$IDF_TARGET/Kconfig.env_caps"
    
    config LED_GPIO
        int "Blink GPIO number"
        range ENV_GPIO_RANGE_MIN ENV_GPIO_OUT_RANGE_MAX
        default 2 if IDF_TARGET_ESP32S3
        default 25
        help
            GPIO number for the LED.

    config BUTTON_GPIO
        int "Button GPIO number"
        range ENV_GPIO_RANGE_MIN ENV_GPIO_OUT_RANGE_MAX
        default 13
        help
            GPIO number for the button

endmenu
```

## EFE6_Website/wifi_config/sdkconfig.defaults
```kconfig
CONFIG_IDF_TARGET_ESP32S3=y
CONFIG_ESPTOOLPY_BAUD_921600B=y
CONFIG_ESPTOOLPY_FLASH_MODE_AUTO_DETECT=y
CONFIG_ESPTOOLPY_FLASHMODE_QIO=y
CONFIG_ESPTOOLPY_FLASH_SAMPLE_MODE_STR=y
CONFIG_ESPTOOLPY_FLASHFREQ_40M=y
CONFIG_ESPTOOLPY_FLASHFREQ_40M_DEFAULT=y
CONFIG_ESPTOOLPY_FLASHSIZE_16MB=y
CONFIG_ESPTOOLPY_HEADER_FLASHSIZE_UPDATE=y
CONFIG_SPIFFS_OBJ_NAME_LEN=128
CONFIG_LITTLEFS_OBJ_NAME_LEN=128
CONFIG_ESP_MAIN_TASK_STACK_SIZE=10240
CONFIG_HTTPD_WS_SUPPORT=y
CONFIG_FREERTOS_USE_TICKLESS_IDLE=y
CONFIG_FREERTOS_HZ=1000
CONFIG_BOOTLOADER_SKIP_VALIDATE_IN_DEEP_SLEEP=y
CONFIG_PARTITION_TABLE_CUSTOM=y
CONFIG_PARTITION_TABLE_CUSTOM_FILENAME="partitions_16M.csv"
CONFIG_PARTITION_TABLE_FILENAME="partitions_16M.csv"
CONFIG_APP_PROJECT_VER_FROM_CONFIG=y
CONFIG_APP_PROJECT_VER="8BEF"
CONFIG_PM_ENABLE=y
CONFIG_PM_DFS_INIT_AUTO=y
CONFIG_PM_POWER_DOWN_CPU_IN_LIGHT_SLEEP=n
CONFIG_PM_SLP_IRAM_OPT=y
CONFIG_PM_RTOS_IDLE_OPT=y
CONFIG_PM_SLP_DISABLE_GPIO=n
CONFIG_LWIP_MAX_SOCKETS=16
```
